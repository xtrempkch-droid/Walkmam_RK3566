/dts-v1/;
/plugin/;

/*
 * Overlay de painel gerado por tools/panel_overlay_from_dts.py
 * a partir de: devices\game-console-r35s\dts\mipis-panel4-V22.dts
 *
 * Instalar como overlays/mipi-panel.dtbo na partição de boot (ver
 * docs/r35s-rk3326.md). Trocar o arquivo troca o modelo de tela:
 * o R35S/R36S sai de fábrica com painéis diferentes.
 *
 * Não editar à mão: rode o script de novo.
 */
/*
 * ATENÇÃO: flags 0xa03 -> 0xe03: bit 0x400 (MIPI_DSI_MODE_VIDEO) que o generic-dsi espera
 * ATENÇÃO: modo '60Hz': porches do fabricante davam 78.2 fps; vfront-porch 17 -> 173 para bater em 60 fps
 * ATENÇÃO: modo '50Hz': porches do fabricante davam 78.2 fps; vfront-porch 17 -> 308 para bater em 50 fps
 * ATENÇÃO: modo '75Hz': porches do fabricante davam 78.2 fps; vfront-porch 17 -> 39 para bater em 75 fps
 */

/ {
	fragment@0 {
		target-path = "/dsi@ff450000/panel@0";

		__overlay__ {
			compatible = "rocknix,generic-dsi";
			panel_description = "G size=52,70 delays=20,150,20,120,20 format=rgb888 lanes=4 flags=0xe03",
				"M clock=58000 horizontal=640,300,200,300 vertical=480,173,5,13 default=1 # 60",
				"M clock=58000 horizontal=640,300,200,300 vertical=480,308,5,13 # 50",
				"M clock=58000 horizontal=640,300,200,300 vertical=480,39,5,13 # 75",
				"I seq=ff30 # orig_cmd=0x15",
				"I seq=ff52 # orig_cmd=0x15",
				"I seq=ff01 # orig_cmd=0x15",
				"I seq=e300 # orig_cmd=0x15",
				"I seq=2510 # orig_cmd=0x15",
				"I seq=286f # orig_cmd=0x15",
				"I seq=2901 # orig_cmd=0x15",
				"I seq=2adf # orig_cmd=0x15",
				"I seq=2c22 # orig_cmd=0x15",
				"I seq=c30f # orig_cmd=0x15",
				"I seq=379c # orig_cmd=0x15",
				"I seq=38a7 # orig_cmd=0x15",
				"I seq=3941 # orig_cmd=0x15",
				"I seq=8020 # orig_cmd=0x15",
				"I seq=9167 # orig_cmd=0x15",
				"I seq=9267 # orig_cmd=0x15",
				"I seq=a055 # orig_cmd=0x15",
				"I seq=a150 # orig_cmd=0x15",
				"I seq=a358 # orig_cmd=0x15",
				"I seq=a49c # orig_cmd=0x15",
				"I seq=a702 # orig_cmd=0x15",
				"I seq=a801 # orig_cmd=0x15",
				"I seq=a921 # orig_cmd=0x15",
				"I seq=aafc # orig_cmd=0x15",
				"I seq=ab28 # orig_cmd=0x15",
				"I seq=ac06 # orig_cmd=0x15",
				"I seq=ad06 # orig_cmd=0x15",
				"I seq=ae06 # orig_cmd=0x15",
				"I seq=af03 # orig_cmd=0x15",
				"I seq=b008 # orig_cmd=0x15",
				"I seq=b126 # orig_cmd=0x15",
				"I seq=b228 # orig_cmd=0x15",
				"I seq=b328 # orig_cmd=0x15",
				"I seq=b403 # orig_cmd=0x15",
				"I seq=b508 # orig_cmd=0x15",
				"I seq=b626 # orig_cmd=0x15",
				"I seq=b708 # orig_cmd=0x15",
				"I seq=b826 # orig_cmd=0x15",
				"I seq=2c22 # orig_cmd=0x15",
				"I seq=5c40 # orig_cmd=0x15",
				"I seq=c000 # orig_cmd=0x15",
				"I seq=c100 # orig_cmd=0x15",
				"I seq=c200 # orig_cmd=0x15",
				"I seq=ff30 # orig_cmd=0x15",
				"I seq=ff52 # orig_cmd=0x15",
				"I seq=ff02 # orig_cmd=0x15",
				"I seq=b002 # orig_cmd=0x15",
				"I seq=d002 # orig_cmd=0x15",
				"I seq=b10f # orig_cmd=0x15",
				"I seq=d110 # orig_cmd=0x15",
				"I seq=b211 # orig_cmd=0x15",
				"I seq=d212 # orig_cmd=0x15",
				"I seq=b332 # orig_cmd=0x15",
				"I seq=d333 # orig_cmd=0x15",
				"I seq=b436 # orig_cmd=0x15",
				"I seq=d436 # orig_cmd=0x15",
				"I seq=b53c # orig_cmd=0x15",
				"I seq=d53c # orig_cmd=0x15",
				"I seq=b620 # orig_cmd=0x15",
				"I seq=d620 # orig_cmd=0x15",
				"I seq=b73e # orig_cmd=0x15",
				"I seq=d73e # orig_cmd=0x15",
				"I seq=b80e # orig_cmd=0x15",
				"I seq=d80d # orig_cmd=0x15",
				"I seq=b905 # orig_cmd=0x15",
				"I seq=d905 # orig_cmd=0x15",
				"I seq=ba11 # orig_cmd=0x15",
				"I seq=da12 # orig_cmd=0x15",
				"I seq=bb11 # orig_cmd=0x15",
				"I seq=db11 # orig_cmd=0x15",
				"I seq=bc13 # orig_cmd=0x15",
				"I seq=dc14 # orig_cmd=0x15",
				"I seq=bd14 # orig_cmd=0x15",
				"I seq=dd14 # orig_cmd=0x15",
				"I seq=be16 # orig_cmd=0x15",
				"I seq=de18 # orig_cmd=0x15",
				"I seq=bf0e # orig_cmd=0x15",
				"I seq=df0f # orig_cmd=0x15",
				"I seq=c017 # orig_cmd=0x15",
				"I seq=e017 # orig_cmd=0x15",
				"I seq=c107 # orig_cmd=0x15",
				"I seq=e108 # orig_cmd=0x15",
				"I seq=ff30 # orig_cmd=0x15",
				"I seq=ff52 # orig_cmd=0x15",
				"I seq=ff03 # orig_cmd=0x15",
				"I seq=088a # orig_cmd=0x15",
				"I seq=098b # orig_cmd=0x15",
				"I seq=3000 # orig_cmd=0x15",
				"I seq=3100 # orig_cmd=0x15",
				"I seq=3200 # orig_cmd=0x15",
				"I seq=3300 # orig_cmd=0x15",
				"I seq=3461 # orig_cmd=0x15",
				"I seq=35d4 # orig_cmd=0x15",
				"I seq=3624 # orig_cmd=0x15",
				"I seq=3703 # orig_cmd=0x15",
				"I seq=4086 # orig_cmd=0x15",
				"I seq=4187 # orig_cmd=0x15",
				"I seq=4284 # orig_cmd=0x15",
				"I seq=4385 # orig_cmd=0x15",
				"I seq=4411 # orig_cmd=0x15",
				"I seq=45de # orig_cmd=0x15",
				"I seq=46dd # orig_cmd=0x15",
				"I seq=4711 # orig_cmd=0x15",
				"I seq=48e0 # orig_cmd=0x15",
				"I seq=49df # orig_cmd=0x15",
				"I seq=5082 # orig_cmd=0x15",
				"I seq=5183 # orig_cmd=0x15",
				"I seq=5280 # orig_cmd=0x15",
				"I seq=5381 # orig_cmd=0x15",
				"I seq=5411 # orig_cmd=0x15",
				"I seq=55e2 # orig_cmd=0x15",
				"I seq=56e1 # orig_cmd=0x15",
				"I seq=5711 # orig_cmd=0x15",
				"I seq=58e4 # orig_cmd=0x15",
				"I seq=59e3 # orig_cmd=0x15",
				"I seq=820f # orig_cmd=0x15",
				"I seq=830f # orig_cmd=0x15",
				"I seq=8400 # orig_cmd=0x15",
				"I seq=850f # orig_cmd=0x15",
				"I seq=860f # orig_cmd=0x15",
				"I seq=870e # orig_cmd=0x15",
				"I seq=880e # orig_cmd=0x15",
				"I seq=8906 # orig_cmd=0x15",
				"I seq=8a06 # orig_cmd=0x15",
				"I seq=8b07 # orig_cmd=0x15",
				"I seq=8c07 # orig_cmd=0x15",
				"I seq=8d04 # orig_cmd=0x15",
				"I seq=8e04 # orig_cmd=0x15",
				"I seq=8f05 # orig_cmd=0x15",
				"I seq=9005 # orig_cmd=0x15",
				"I seq=980f # orig_cmd=0x15",
				"I seq=990f # orig_cmd=0x15",
				"I seq=9a00 # orig_cmd=0x15",
				"I seq=9b0f # orig_cmd=0x15",
				"I seq=9c0f # orig_cmd=0x15",
				"I seq=9d0e # orig_cmd=0x15",
				"I seq=9e0e # orig_cmd=0x15",
				"I seq=9f06 # orig_cmd=0x15",
				"I seq=a006 # orig_cmd=0x15",
				"I seq=a107 # orig_cmd=0x15",
				"I seq=a207 # orig_cmd=0x15",
				"I seq=a304 # orig_cmd=0x15",
				"I seq=a404 # orig_cmd=0x15",
				"I seq=a505 # orig_cmd=0x15",
				"I seq=a605 # orig_cmd=0x15",
				"I seq=e002 # orig_cmd=0x15",
				"I seq=e152 # orig_cmd=0x15",
				"I seq=ff30 # orig_cmd=0x15",
				"I seq=ff52 # orig_cmd=0x15",
				"I seq=ff00 # orig_cmd=0x15",
				"I seq=3602 # orig_cmd=0x15",
				"I seq=11 wait=200 # orig_cmd=0x5",
				"I seq=29 wait=20 # orig_cmd=0x5",
				"#END";
		};
	};
};
